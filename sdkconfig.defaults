## sdkconfig.defaults
```kconfig
CONFIG_ESPTOOLPY_FLASHSIZE_32MB=y
CONFIG_FATFS_LFN_HEAP=y
CONFIG_HTTPD_MAX_REQ_HDR_LEN=1024
CONFIG_PARTITION_TABLE_CUSTOM_FILENAME="partitions_example.csv"
CONFIG_PARTITION_TABLE_CUSTOM=y
CONFIG_PARTITION_TABLE_FILENAME="partitions_example.csv"
CONFIG_SPIFFS_OBJ_NAME_LEN=64
CONFIG_TINYUSB_NET_MODE_NCM=y
CONFIG_TINYUSB_CDC_ENABLED=y
CONFIG_SPIRAM=y
CONFIG_SPIRAM_MODE_OCT=y
CONFIG_SPIRAM_SPEED_80M=y
CONFIG_SPIRAM_BOOT_INIT=y
```
